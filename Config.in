## Config.in
```kconfig
source "$BR2_EXTERNAL_IOT_GW_PATH/package/optee_client/Config.in"
source "$BR2_EXTERNAL_IOT_GW_PATH/package/optee_test/Config.in"
source "$BR2_EXTERNAL_IOT_GW_PATH/package/optee_examples/Config.in"
source "$BR2_EXTERNAL_IOT_GW_PATH/package/optee_os/Config.in"

source "$BR2_EXTERNAL_IOT_GW_PATH/package/arm_tf/Config.in"

source "$BR2_EXTERNAL_IOT_GW_PATH/package/kmod_header/Config.in"
source "$BR2_EXTERNAL_IOT_GW_PATH/package/kmod_pslist/Config.in"
```

## old_build/rpi3/raspberrypi3_64_custom_defconfig
```kconfig
BR2_aarch64=y
BR2_ARM_FPU_VFPV4=y
BR2_JLEVEL=0
BR2_TOOLCHAIN_EXTERNAL=y
BR2_TOOLCHAIN_EXTERNAL_PREINSTALLED=y
BR2_TOOLCHAIN_EXTERNAL_PATH="topkek"
BR2_SYSTEM_DHCP="eth0"
BR2_ROOTFS_OVERLAY="overlay"
BR2_ROOTFS_POST_BUILD_SCRIPT="board/raspberrypi3-64/post-build.sh"
BR2_LINUX_KERNEL=y
BR2_LINUX_KERNEL_CUSTOM_GIT=y
BR2_LINUX_KERNEL_CUSTOM_REPO_URL="https://github.com/linaro-swg/linux.git"
BR2_LINUX_KERNEL_CUSTOM_REPO_VERSION="rpi3-optee-4.6"
BR2_LINUX_KERNEL_DEFCONFIG="bcmrpi3"
BR2_LINUX_KERNEL_CONFIG_FRAGMENT_FILES="rpi3.conf"
BR2_LINUX_KERNEL_DTS_SUPPORT=y
BR2_LINUX_KERNEL_INTREE_DTS_NAME="broadcom/bcm2710-rpi-3-b"
BR2_PACKAGE_RPI_FIRMWARE=y
# BR2_PACKAGE_RPI_FIRMWARE_INSTALL_DTB_OVERLAYS is not set
BR2_PACKAGE_HOST_DOSFSTOOLS=y
BR2_PACKAGE_HOST_E2FSPROGS=y
BR2_PACKAGE_HOST_GENIMAGE=y
BR2_PACKAGE_HOST_MTOOLS=y
```

## package/arm_tf/Config.in
```kconfig
config BR2_PACKAGE_OPTEE_OS
	bool "optee_os"
	help
	  http://github.org/OP-TEE/optee_os

if BR2_PACKAGE_OPTEE_OS
config BR2_PACKAGE_OPTEE_OS_SITE
	string "OP-TEE os path"
	default ""
	help
	  The path to the source directory of OP-TEE os
endif
```

## package/kmod_header/Config.in
```kconfig
config BR2_PACKAGE_KMOD_HEADER
	bool "kmod_header"
	default "y"
	depends on BR2_LINUX_KERNEL
	help
		Dummy kernel module for kernel struct generation

if BR2_PACKAGE_KMOD_HEADER
config BR2_PACKAGE_KMOD_HEADER_SITE
	string "Dummy kernel module path"
	default ""
	help
	  The path to the source directory of the dummy kernel module
endif
```

## package/kmod_pslist/Config.in
```kconfig
config BR2_PACKAGE_KMOD_PSLIST
	bool "kmod_pslist"
	default "y"
	depends on BR2_LINUX_KERNEL
	help
		Process list kernel module

if BR2_PACKAGE_KMOD_PSLIST
config BR2_PACKAGE_KMOD_PSLIST_SITE
	string "Process list kernel module path"
	default "https://github.com/realmoriss/kmod-pslist.git"
	help
	  The path to the source directory of the process list kernel module
endif
```

## package/optee_client/Config.in
```kconfig
config BR2_PACKAGE_OPTEE_CLIENT
	bool "optee_client"
	help
	  http://github.org/OP-TEE/optee_client

if BR2_PACKAGE_OPTEE_CLIENT
config BR2_PACKAGE_OPTEE_CLIENT_SITE
	string "OP-TEE client path"
	default "https://github.org/OP-TEE/optee_client.git"
	help
	  The path to the source directory of OP-TEE client
endif
```

## package/optee_examples/Config.in
```kconfig
config BR2_PACKAGE_OPTEE_EXAMPLES
	bool "optee_examples"
	help
	  http://github.org/OP-TEE/optee_examples

if BR2_PACKAGE_OPTEE_EXAMPLES

config BR2_PACKAGE_OPTEE_EXAMPLES_SITE
	string "OP-TEE examples path"
	default "https://github.org/OP-TEE/optee_examples.git"
	help
	  The path to the source directory of OP-TEE examples

endif
```
